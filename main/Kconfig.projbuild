## main/Kconfig.projbuild
```kconfig
menu "control stationconfig"

    config EXAMPLE_IPV4
        bool "IPV4"
        default y

    config EXAMPLE_IPV6
        bool "IPV6"
        default n
        select EXAMPLE_CONNECT_IPV6

    config PORT_SERVER
        int "Port"
        range 0 65535
        default 5010
        help
            Local port the example server will listen on.

    config ESP_MAXIMUM_RETRY
        int "Maximum retry"
        default 5
        help
            Set the Maximum retry to avoid station reconnecting to the AP unlimited when the AP is really inexistent.

    config MQTT_SERVER
        string "MQTT server"
        default "mqtt://192.168.0.100:1883"
        help
            MQTT server addres

    config OPEN_WEATHER_API_KEY
        string "KEY FOR OpenWheather"
        default ""
        help
            Enter key for Open wheather; get from https://openweathermap.org/price
            
    config ESP_DPP_LISTEN_CHANNEL_LIST
        string "DPP Listen channel list"
        default "6"
        help
            DPP Bootstrapping listen channels separated by commas.

    config ESP_DPP_BOOTSTRAPPING_KEY
        string "Bootstrapping key"
        help
            64 hex digits (or 32 bytes) of raw private key for DPP Bootstrapping.

    config ESP_DPP_DEVICE_INFO
        string "Additional Device Info"
        default "esp32"
        help
            Additional ancillary information to be included in QR Code.

endmenu
```

## sdkconfig.defaults
```kconfig
# cip:esp32-solo-1 
# board:meteoControlStation_v3

#
# Serial flasher config
#
CONFIG_ESPTOOLPY_FLASHSIZE_4MB=y
CONFIG_ESPTOOLPY_FLASHSIZE="2MB"

#
# Partition Table
#
CONFIG_PARTITION_TABLE_CUSTOM=y
CONFIG_PARTITION_TABLE_CUSTOM_FILENAME="partitions_custom.csv"
CONFIG_PARTITION_TABLE_FILENAME="partitions_custom.csv"

#
# ESP System Settings
#
CONFIG_ESP_SYSTEM_SINGLE_CORE_MODE=y
CONFIG_ESP_SYSTEM_RTC_FAST_MEM_AS_HEAP_DEPCHECK=y
CONFIG_ESP_SYSTEM_ALLOW_RTC_FAST_MEM_AS_HEAP=y

#
# ESP32-specific
#
CONFIG_ESP32_IRAM_AS_8BIT_ACCESSIBLE_MEMORY=y

#
# FreeRTOS
#
CONFIG_FREERTOS_UNICORE=y
CONFIG_FREERTOS_OPTIMIZED_SCHEDULER=y
CONFIG_FREERTOS_HZ=1000

#
# Supplicant
#
CONFIG_WPA_DPP_SUPPORT=y

#
# Wifi Manager Configuration
#
CONFIG_DEFAULT_AP_SSID="ControlStation"
CONFIG_DEFAULT_AP_PASSWORD=""
CONFIG_DEFAULT_AP_IP="192.168.10.1"
CONFIG_DEFAULT_AP_GATEWAY="192.168.10.1"
CONFIG_DEFAULT_AP_MAX_CONNECTIONS=16

#
# LVGL Color settings
#
CONFIG_LV_COLOR_16_SWAP=y

#
# LVGL Memory settings
#
CONFIG_LV_MEM_SIZE_KILOBYTES=64

#
# LVGL Enable built-in fonts
#
CONFIG_LV_FONT_MONTSERRAT_8=y
CONFIG_LV_FONT_MONTSERRAT_10=y
CONFIG_LV_FONT_MONTSERRAT_12=y
CONFIG_LV_FONT_MONTSERRAT_14=y
CONFIG_LV_FONT_MONTSERRAT_16=y
CONFIG_LV_FONT_MONTSERRAT_18=y
CONFIG_LV_FONT_MONTSERRAT_20=y
CONFIG_LV_FONT_MONTSERRAT_22=y
CONFIG_LV_FONT_MONTSERRAT_24=y
CONFIG_LV_FONT_MONTSERRAT_26=y
CONFIG_LV_FONT_MONTSERRAT_28=y
CONFIG_LV_FONT_MONTSERRAT_30=y
CONFIG_LV_FONT_MONTSERRAT_32=y
CONFIG_LV_FONT_MONTSERRAT_34=y
CONFIG_LV_FONT_MONTSERRAT_36=y
CONFIG_LV_FONT_MONTSERRAT_38=y
CONFIG_LV_FONT_MONTSERRAT_40=y
CONFIG_LV_FONT_MONTSERRAT_42=y
CONFIG_LV_FONT_MONTSERRAT_44=y
CONFIG_LV_FONT_MONTSERRAT_46=y
CONFIG_LV_FONT_MONTSERRAT_48=y
CONFIG_LV_FONT_UNSCII_16=y
CONFIG_LV_FONT_DEFAULT_MONTSERRAT_16=y

#
# LVGL 3rd Party Libraries
#
CONFIG_LV_USE_PNG=y
CONFIG_LV_USE_QRCODE=y

#
# LVGL TFT Display controller
#
CONFIG_LV_DISPLAY_ORIENTATION_LANDSCAPE_INVERTED=y
CONFIG_LV_DISPLAY_ORIENTATION=3
CONFIG_CUSTOM_DISPLAY_BUFFER_SIZE=y
CONFIG_CUSTOM_DISPLAY_BUFFER_BYTES=32768
CONFIG_LV_TFT_DISPLAY_SPI3_HOST=y

#
# LVGL Display Pin Assignments
#
CONFIG_LV_DISP_SPI_MOSI=23
CONFIG_LV_DISPLAY_USE_SPI_MISO=y
CONFIG_LV_DISP_SPI_MISO=19
CONFIG_LV_DISP_SPI_INPUT_DELAY_NS=0
CONFIG_LV_DISP_SPI_CLK=18
CONFIG_LV_DISPLAY_USE_SPI_CS=y
CONFIG_LV_DISP_SPI_CS=13
CONFIG_LV_DISPLAY_USE_DC=y
CONFIG_LV_DISP_PIN_DC=5
CONFIG_LV_DISP_USE_RST=y
CONFIG_LV_DISP_PIN_RST=15
CONFIG_LV_DISP_PIN_BUSY=35

CONFIG_LV_DISP_BACKLIGHT_PWM=y
CONFIG_LV_DISP_PIN_BCKL=20
```
